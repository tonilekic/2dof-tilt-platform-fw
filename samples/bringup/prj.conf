## CMakeLists.txt
```
# Copyright (c) 2026 Toni Lekic
# SPDX-License-Identifier: Apache-2.0

cmake_minimum_required(VERSION 3.20.0)
find_package(Zephyr REQUIRED HINTS $ENV{ZEPHYR_BASE})

project(bringup)

target_sources(app PRIVATE src/main.c)
```

## prj.conf
```kconfig
# Copyright (c) 2026 Toni Lekic
# SPDX-License-Identifier: Apache-2.0

# --------------------------------------------------
# Bringup sample: GPIO shell for PCB testing
# --------------------------------------------------

# GPIO and GPIO shell commands (gpio conf, gpio set, gpio get, ...)
CONFIG_GPIO=y
CONFIG_GPIO_SHELL=y

# Shell subsystem
CONFIG_SHELL=y

# USB CDC ACM console (XIAO nRF52840 uses native USB for serial)
CONFIG_USB_DEVICE_STACK_NEXT=y
CONFIG_CDC_ACM_SERIAL_INITIALIZE_AT_BOOT=y
CONFIG_UART_LINE_CTRL=y

# Logging
CONFIG_LOG=y
```

## src/main.c
```c
/*
 * Copyright (c) 2026 Toni Lekic
 * SPDX-License-Identifier: Apache-2.0
 *
 * Bringup sample – GPIO shell for PCB testing.
 *
 * This sample provides an interactive shell over USB CDC ACM with the
 * built-in Zephyr GPIO shell commands. Use it to toggle individual
 * pins and verify the circuit on the 2dof-tilt-platform PCB.
 */

#include <zephyr/kernel.h>

int main(void)
{
	/* The shell subsystem runs in its own thread – nothing to do here. */
	return 0;
}
```
